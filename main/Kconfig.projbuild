## main/Kconfig.projbuild
```kconfig
menu "Halow RTOS Configuration"

    config CONSOLE_MAX_COMMAND_LINE_LENGTH
        int "Maximum command line length"
        default 256
        range 64 4096
        help
            This value marks the maximum length of a single command line. Once it is
            reached, no more characters will be accepted by the console.
            
            Smaller values save memory, larger values allow longer commands.
            Default: 256 bytes (sufficient for most use cases)

    config LOGIN_DEBUG_ENABLE
        bool "Enable login debug messages"
        default false
        help
            Enable detailed debug messages for the login system.
            This includes NVS operations, credential storage, and authentication details.
            
            Recommended to keep disabled for production builds to reduce log noise.
            Enable only for debugging login issues.

    config SYSTEM_LOG_ENABLE
        bool "Enable system log messages"
        default false
        help
            Enable system log messages during boot and operation.
            This includes ESP-IDF component logs, task watchdog messages, etc.
            
            When disabled, provides clean console output focused on user interaction.
            Enable for debugging system issues or development.

endmenu

menu "HaLow WiFi Configuration"

    config MM_RESET_N
        int "RESET_N pin for MM chip"
        default 8
        help
            Output gpio pin used to control the RESET_N line.

    config MM_WAKE
        int "WAKE pin for MM chip"
        default 9
        help
            Output gpio pin used to control the WAKE line.

    config MM_BUSY
        int "BUSY pin for the MM chip"
        default 7
        help
            Input pin used as a rising edge interrupt.

    config MM_SPI_SCK
        int "SCK pin for MM chip"
        default 4
        help
            SPI clock pin.

    config MM_SPI_MOSI
        int "MOSI pin for MM chip"
        default 3
        help
            SPI master out slave in pin.

    config MM_SPI_MISO
        int "MISO pin for MM chip"
        default 5
        help
            SPI master in slave out pin.

    config MM_SPI_CS
        int "SPI CS pin for MM chip"
        default 2
        help
            SPI chip select pin.

    config MM_SPI_IRQ
        int "SPI IRQ pin for MM chip"
        default 6
        help
            Out of band interupt pin used to indicate that
            the MM chip has data for the host.

    choice MM_BCF
        prompt "BCF to link when building the FW"
        default MM_BCF_MF08651_US
        help
            The Board Configuration File (BCF) is a configuration file for the Morse Micro chip.

        config MM_BCF_MF08651_US
            bool  "mf08651_us"
        config MM_BCF_MF08551
            bool  "mf08551"
        config MM_BCF_MF08251
            bool  "mf08251"
        config MM_BCF_MF03120
            bool  "mf03120"
        config MM_BCF_AW_HM593
            bool  "aw_hm593"
        config MM_BCF_AW_HM593_4V3
            bool  "aw_hm593_4v3"
    endchoice

endmenu
```

## sdkconfig.defaults
```kconfig
# HaLow Pin Configuration
CONFIG_MM_RESET_N=8
CONFIG_MM_WAKE=9
CONFIG_MM_BUSY=7
CONFIG_MM_SPI_SCK=4
CONFIG_MM_SPI_MOSI=3
CONFIG_MM_SPI_MISO=5
CONFIG_MM_SPI_CS=2
CONFIG_MM_SPI_IRQ=6
```
